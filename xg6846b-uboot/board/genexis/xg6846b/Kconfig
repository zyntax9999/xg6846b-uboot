## xg6846b-uboot/board/genexis/xg6846b/Kconfig
```kconfig
# SPDX-License-Identifier: GPL-2.0+

if TARGET_XG6846B

config SYS_BOARD
	default "xg6846b"

config SYS_VENDOR
	default "genexis"

config SYS_SOC
	default "bcm6846"

config SYS_CONFIG_NAME
	default "xg6846b"

config BCM6846_ETH
	bool "BCM6846 XRDP Ethernet driver"
	depends on DM_ETH
	select BCM6846_MDIO
	default y
	help
	  Ethernet driver for the Broadcom BCM6846 (BCM68460) SoC.
	  Uses the XRDP Runner data-path with SBPM packet buffers for
	  TX and RX.  The UniMAC EMAC0 is connected via RGMII to the
	  Marvell 88E6320 switch CPU port.

	  Required for TFTP firmware updates and network boot on the
	  Genexis XG6846B.

config BCM6846_MDIO
	bool "BCM6846 MDIO bus driver"
	depends on DM_MDIO
	default y
	help
	  MDIO bus driver for the BCM6846 hardware MDIO controller.
	  Required for 88E6320 switch initialisation and internal PHY
	  management.

endif
```

## xg6846b-uboot/configs/xg6846b_defconfig
```kconfig
# SPDX-License-Identifier: GPL-2.0+
#
# U-Boot defconfig for Genexis XG6846B
# Target: OpenWrt development / network boot / firmware update
#
# Build with:
#   make CROSS_COMPILE=arm-linux-gnueabihf- xg6846b_defconfig
#   make CROSS_COMPILE=arm-linux-gnueabihf- -j$(nproc)

CONFIG_ARM=y
CONFIG_ARCH_BCM68XX=y
CONFIG_SYS_SOC="bcm6846"
CONFIG_SYS_CONFIG_NAME="xg6846b"
CONFIG_TARGET_XG6846B=y

# ================================================================
# CPU / clock
# ================================================================
CONFIG_CPU_V7A=y
CONFIG_SYS_TEXT_BASE=0x81f00000
CONFIG_SYS_CLK_FREQ=1500000000

# ================================================================
# Memory
# ================================================================
CONFIG_SYS_MALLOC_F_LEN=0x4000
CONFIG_NR_DRAM_BANKS=1
CONFIG_SYS_SDRAM_SIZE=0x10000000

# ================================================================
# SPL
# ================================================================
# CONFIG_SPL is not set   # Enable if full SPL chain is needed

# ================================================================
# Console / UART
# ================================================================
CONFIG_DM_SERIAL=y
CONFIG_BCM6345_SERIAL=y
CONFIG_BAUDRATE=115200
CONFIG_SYS_BAUDRATE_TABLE="9600,19200,38400,57600,115200"
CONFIG_CONS_INDEX=1

# ================================================================
# Environment
# ================================================================
CONFIG_ENV_IS_IN_NAND=y
CONFIG_ENV_SIZE=0x20000
CONFIG_ENV_OFFSET=0x1f00000
CONFIG_ENV_OFFSET_REDUND=0x1f20000
CONFIG_BOOTDELAY=3
CONFIG_USE_BOOTCOMMAND=y
CONFIG_BOOTCOMMAND="nand read 0x81000000 0x100000 0x1e00000; bootm 0x81000000"

# ================================================================
# Command set (trimmed for embedded target)
# ================================================================
CONFIG_CMD_BOOTM=y
CONFIG_CMD_BOOTZ=y
CONFIG_CMD_BOOTI=y       # ARM64 compat
CONFIG_CMD_ENV=y
CONFIG_CMD_NAND=y
CONFIG_CMD_NET=y
CONFIG_CMD_DHCP=y
CONFIG_CMD_PING=y
CONFIG_CMD_TFTPBOOT=y
CONFIG_CMD_MII=y
CONFIG_CMD_MDIO=y
CONFIG_CMD_GPIO=y
CONFIG_CMD_MEMORY=y
CONFIG_CMD_I2C=y
CONFIG_CMD_MISC=y
CONFIG_CMD_EDITENV=y
CONFIG_CMD_SAVEENV=y
CONFIG_CMD_IMPORTENV=y
CONFIG_CMD_EXPORTENV=y
CONFIG_CMD_ECHO=y
CONFIG_CMD_SETEXPR=y
CONFIG_CMD_TIME=y
CONFIG_CMD_SLEEP=y
CONFIG_CMD_RUN=y
CONFIG_CMD_RESET=y

# Disable unused commands
# CONFIG_CMD_FPGA is not set
# CONFIG_CMD_USB is not set
# CONFIG_CMD_MMC is not set
# CONFIG_CMD_PCI is not set

# ================================================================
# Device Model
# ================================================================
CONFIG_DM=y
CONFIG_DM_ETH=y
CONFIG_DM_MDIO=y
CONFIG_DM_GPIO=y
CONFIG_DM_SERIAL=y
CONFIG_DM_I2C=y

# ================================================================
# NAND
# ================================================================
CONFIG_MTD=y
CONFIG_MTD_RAW_NAND=y
CONFIG_NAND_BRCMNAND=y
CONFIG_SYS_MAX_NAND_DEVICE=1
CONFIG_SYS_NAND_SELF_INIT=y

# ================================================================
# Network
# ================================================================
CONFIG_NET=y
CONFIG_NET_TFTP_VARS=y
CONFIG_BCM6846_ETH=y          # BCM6846 XRDP ethernet driver
CONFIG_BCM6846_MDIO=y         # BCM6846 MDIO bus driver
CONFIG_PHY_MARVELL=y          # 88E6320 PHY support
CONFIG_NET_RETRY_COUNT=10
CONFIG_TFTP_BLOCKSIZE=1468
CONFIG_TFTP_WINDOWSIZE=1

# ================================================================
# Bootloader image formats
# ================================================================
CONFIG_FIT=y
CONFIG_FIT_VERBOSE=y
CONFIG_LEGACY_IMAGE_FORMAT=y
CONFIG_OF_LIBFDT=y
CONFIG_OF_BOARD_SETUP=y

# ================================================================
# Compression
# ================================================================
CONFIG_LZO=y
CONFIG_GZIP=y
CONFIG_BZIP2=y

# ================================================================
# Misc
# ================================================================
CONFIG_DISPLAY_BOARDINFO=y
CONFIG_DISPLAY_CPUINFO=y
CONFIG_SYS_PROMPT="XG6846B> "
CONFIG_SYS_CBSIZE=1024
CONFIG_SYS_MAXARGS=32
CONFIG_AUTOBOOT_KEYED=y
CONFIG_AUTOBOOT_PROMPT="Press any key to stop autoboot: %2d "

# ================================================================
# OpenWrt-specific: enable TFTP firmware update workflow
# ================================================================
CONFIG_CMD_TFTPPUT=y
CONFIG_HASH=y
CONFIG_CMD_HASH=y
CONFIG_SHA256=y

# ================================================================
# Debug (disable for production)
# ================================================================
# CONFIG_PANIC_HANG is not set
# CONFIG_DISPLAY_BOARDINFO_LATE is not set
```
